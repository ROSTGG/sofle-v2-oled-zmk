## config/west.yml
```yaml
manifest:
  remotes:
    - name: zmkfirmware
      url-base: https://github.com/zmkfirmware
  projects:
    - name: zmk
      remote: zmkfirmware
      revision: v0.3
      import: app/west.yml
   # dongle_display!view
    - name: zmk-dongle-display-view
      remote: mctechnology17
      revision: main
  self:
    path: config
```
